## boards/shields/ergotravel/Kconfig.defconfig
```kconfig
if SHIELD_ERGOTRAVEL_LEFT

# Name must be less than 16 characters long!
config ZMK_KEYBOARD_NAME
    default "ErgoTravel"

config ZMK_SPLIT_ROLE_CENTRAL
    default y

endif

if SHIELD_ERGOTRAVEL_LEFT || SHIELD_ERGOTRAVEL_RIGHT

config ZMK_SPLIT
    default y

endif
```

## boards/shields/ergotravel/Kconfig.shield
```kconfig
# Copyright (c) 2024 Maximilian Hantsch
# SPDX-License-Identifier: MIT

# No whitespace after the comma or in your part name!
config SHIELD_ERGOTRAVEL_LEFT
    def_bool $(shields_list_contains,ergotravel_left)

# No whitespace after the comma or in your part name!
config SHIELD_ERGOTRAVEL_RIGHT
    def_bool $(shields_list_contains,ergotravel_right)
```

## config/west.yml
```yaml
manifest:
  remotes:
    - name: zmkfirmware
      url-base: https://github.com/zmkfirmware
    # Additional modules containing boards/shields/custom code can be listed here as well
    # See https://docs.zephyrproject.org/3.2.0/develop/west/manifest.html#projects
    - name: kbrd-space
      url-base: https://github.com/kbrd-space
  projects:
    - name: zmk
      remote: zmkfirmware
      revision: v0.3
      import: app/west.yml
    - name: zmk-anti-idle
      remote: kbrd-space
      revision: main
  self:
    path: config
```
